## myapps/audiofilesender/Kconfig
```kconfig
config AUDIOFILESENDER
	tristate "User app : audiofilesender app"
	default n
	---help---
		Enable the audiofilesender app

if AUDIOFILESENDER

config AUDIOFILESENDER_PROGNAME
	string "Program name"
	default "audiofilesender"
	---help---
		This is the name of the program that will be use when the NSH ELF
		program is installed.

config AUDIOFILESENDER_PRIORITY
	int "audiofilesender task priority"
	default 100

config AUDIOFILESENDER_STACKSIZE
	int "audiofilesender stack size"
	default 2048

endif
```

## myapps/audiofilestreamer/Kconfig
```kconfig
config AUDIOFILESTREAMER
	tristate "User app : audiofilestreamer app"
	default n
	---help---
		Enable the audiofilestreamer app

if AUDIOFILESTREAMER

config AUDIOFILESTREAMER_PROGNAME
	string "Program name"
	default "audiofilestreamer"
	---help---
		This is the name of the program that will be use when the NSH ELF
		program is installed.

config AUDIOFILESTREAMER_PRIORITY
	int "audiofilestreamer task priority"
	default 100

config AUDIOFILESTREAMER_STACKSIZE
	int "audiofilestreamer stack size"
	default 2048

endif
```
